## boards/shields/grekozen/Kconfig.shield
```kconfig
# Copyright (c) 2020 Pete Johanson
# SPDX-License-Identifier: MIT

config SHIELD_GREKOZEN_LEFT
    def_bool $(shields_list_contains,grekozen_left)

config SHIELD_GREKOZEN_RIGHT
    def_bool $(shields_list_contains,grekozen_right)

config SHIELD_GREKOZEN_DONGLE
    def_bool $(shields_list_contains,grekozen_dongle)
```
